/include/ "system-conf.dtsi"
/ {
};   
&spi0 {
            #compatible = "xlnx,zynq-spi-r1p6";
            #reg = <0xe0006000 0x1000>;
            status = "okay";
            #interrupt-parent = <0x4>;
            #interrupts = <0x0 0x1a 0x4>;
            #clocks = <0x1 0x19 0x1 0x22>;
            #clock-names = "ref_clk", "pclk";
            #address-cells = <0x1>;
            #size-cells = <0x0>;
            is-decoded-cs = <1>;
            num-cs = <1>;
            	spidev@0 {
                compatible = "spidev";
                spi-max-frequency = <3125000>;
                reg = <0>;
            };
};
    

